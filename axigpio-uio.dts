/dts-v1/;/plugin/;
/ {
    fragment@0 {
        target-path = "/axi";
        #address-cells = <2>;
        #size-cells = <2>;
        __overlay__ {
            #address-cells = <2>;
            #size-cells = <2>;

            axigpio-uio {
                compatible = "generic-uio";
                reg = <0x0 0x00A0000000 0x0 0x10000>;
            };
        };
    };
};