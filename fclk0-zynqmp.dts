/dts-v1/;/plugin/;
/ {
    fragment@0 {
        target-path = "/axi";
        __overlay__ {
            fclk0 {
                compatible    = "ikwzm,fclkcfg";
                clocks        = <&zynqmp_clk 71>;
                insert-rate   = "100000000";
                insert-enable = <1>;
                remove-rate   = "1000000";
                remove-enable = <0>;
            };
        };
    };
};